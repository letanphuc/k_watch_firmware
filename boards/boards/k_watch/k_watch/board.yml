## boards/boards/k_watch/k_watch/board.yml
```yaml
board:
  name: k_watch
  full_name: K Watch
  vendor: k_watch
  socs:
    - name: nrf52840
```

## drivers/display/Kconfig
```kconfig
# Kconfig - Display Drivers

menu "Display Drivers"

rsource "lpm013m126a/Kconfig"

endmenu
```

## drivers/display/lpm013m126a/Kconfig
```kconfig
# Kconfig - LPM013M126A Display Driver

config DISPLAY_LPM013M126A
	bool "JDI LPM013M126A Display Driver"
	default y
	depends on DT_HAS_JDI_LPM013M126A_ENABLED
	select SPI
	help
	  Enable support for JDI LPM013M126A Memory LCD.
```

## drivers/haptics/Kconfig
```kconfig
#Copyright(c) 2024 Nordic Semiconductor ASA
#SPDX - License - Identifier : Apache - 2.0

menuconfig HAPTICS
	bool "Haptics drivers"
	help
	  Enable haptics drivers.

if HAPTICS

config HAPTICS_LOG_LEVEL
	int "Log level"
	default 3
	help
	  Log level for haptics drivers.

config HAPTICS_INIT_PRIORITY
	int "Init priority"
	default 80
	help
	  Haptics driver initialization priority.

config DRV2603
	bool "DRV2603 haptic driver"
	default y
	depends on DT_HAS_TI_DRV2603_ENABLED
	select PWM
	select GPIO
	help
	  Enable DRV2603 haptic driver.

endif # HAPTICS
```

## dts/bindings/display/jdi,lpm013m126a.yaml
```yaml
# JDI LPM013M126A Display Binding

description: JDI LPM013M126A 176x176 Memory LCD

compatible: "jdi,lpm013m126a"

include: [spi-device.yaml]

properties:
  width:
    type: int
    required: true
    description: Display width in pixels

  height:
    type: int
    required: true
    description: Display height in pixels

  disp-en-gpios:
    type: phandle-array
    required: false
    description: Display enable pin (DISP)

  extcomin-gpios:
    type: phandle-array
    required: false
    description: External COM inversion pin (EXTCOMIN)

  pwms:
    type: phandle-array
    required: false
    description: Backlight PWM channel
```

## dts/bindings/haptics/ti,drv2603.yaml
```yaml
# Copyright (c) 2024 Nordic Semiconductor ASA
# SPDX-License-Identifier: Apache-2.0

description: TI DRV2603 Haptic Driver

compatible: "ti,drv2603"

include: base.yaml

properties:
  en-gpios:
    type: phandle-array
    required: true
    description: Enable GPIO pin

  pwms:
    type: phandle-array
    required: true
    description: PWM pin for intensity control
```
