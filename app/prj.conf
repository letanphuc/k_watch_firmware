## CMakeLists.txt
```
# SPDX-License-Identifier: Apache-2.0

cmake_minimum_required(VERSION 3.20.0)

find_package(Zephyr REQUIRED HINTS $ENV{ZEPHYR_BASE})
project(hello_world)

FILE(GLOB_RECURSE UI_Sources CONFIGURE_DEPENDS src/ui/*.c)

include_directories(
  /Users/phuc/Work/k_watch_fw/modules/lib/gui
  src
  src/hal
)

target_sources(app PRIVATE
  src/main.c
  src/hal/ble.c
  src/hal/led.c
  src/hal/buttons.c
  src/hal/rtc.c
  src/hal/cts_client.c
  src/hal/ancs_client.c
  src/hal/power.c
  src/app.c
  src/app/modes.c
  src/app/model.c
  src/event.c
  src/app/screens/watchface_screen.c
  src/app/screens/noti_screen.c
  src/driver/LPM013M126A.c
  ${LVGL_FONT_SOURCES}
  ${LVGL_IMAGE_SOURCES}
  ${UI_Sources}
)
```

## prj.conf
```kconfig
# =====================

# =====================
CONFIG_LOG=y
CONFIG_USE_SEGGER_RTT=y
CONFIG_LOG_BACKEND_RTT=y
CONFIG_CONSOLE=y
CONFIG_RTT_CONSOLE=y
CONFIG_UART_CONSOLE=n
CONFIG_LOG_BACKEND_RTT_BUFFER=0

# =====================
# Peripherals
# =====================
# LED Strip (SPI)
CONFIG_LED_STRIP=y
CONFIG_SPI=y
CONFIG_SPI_NRFX_RAM_BUFFER_SIZE=32
CONFIG_GPIO=y
CONFIG_PWM=y

# I2C, RTC, Sensors
CONFIG_I2C=y
CONFIG_RTC=y
CONFIG_RTC_ALARM=y
CONFIG_RTC_UPDATE=y
CONFIG_SENSOR=y
CONFIG_NRF_FUEL_GAUGE=y
CONFIG_NRF_FUEL_GAUGE_VARIANT_SECONDARY_CELL=y
CONFIG_REQUIRES_FLOAT_PRINTF=y

# =====================
# Display (LVGL)
# =====================
CONFIG_LVGL=y
CONFIG_DISPLAY=y
CONFIG_LV_Z_MEM_POOL_SYS_HEAP=y
CONFIG_LV_Z_MEM_POOL_SIZE=32768
CONFIG_LV_COLOR_DEPTH_16=y

# =====================
# Kernel/Stack
# =====================
CONFIG_MAIN_STACK_SIZE=8192
CONFIG_SYSTEM_WORKQUEUE_STACK_SIZE=2048

# =====================
# Power Management
# =====================
CONFIG_POWEROFF=y
CONFIG_PM_DEVICE=y

# =====================
# Bluetooth
# =====================
CONFIG_BT=y
CONFIG_BT_PERIPHERAL=y
CONFIG_BT_DEVICE_NAME="K_Watch"
CONFIG_BT_SMP=y
CONFIG_BT_GATT_CLIENT=y
CONFIG_BT_GATT_DM=y
CONFIG_BT_CTS_CLIENT=y
CONFIG_BT_ANCS_CLIENT=y
CONFIG_BT_GATTP=y

# =====================
# Storage/Settings
# =====================
CONFIG_BT_SETTINGS=y
CONFIG_SETTINGS=y
CONFIG_SETTINGS_NVS=y
CONFIG_FLASH=y
CONFIG_FLASH_PAGE_LAYOUT=y
CONFIG_FLASH_MAP=y

# =====================
# Shell (optional)
# =====================
# CONFIG_SHELL=y
# CONFIG_USE_SEGGER_RTT=y
# CONFIG_SHELL_BACKEND_RTT=y
# CONFIG_RTC_SHELL=y
# CONFIG_SHELL_BACKEND_RTT_BUFFER=0


CONFIG_LV_FONT_MONTSERRAT_14=y
CONFIG_LV_FONT_MONTSERRAT_30=y

CONFIG_FLASH=y
CONFIG_FLASH_MAP=y
CONFIG_SETTINGS=y
CONFIG_SETTINGS_RUNTIME=y
CONFIG_NVS=y
CONFIG_SETTINGS_NVS=y


CONFIG_REBOOT=y

# CONFIG_REGULATOR=y
```

## src/main.c
```c
/*
 * Copyright (c) 2012-2014 Wind River Systems, Inc.
 *
 * SPDX-License-Identifier: Apache-2.0
 */

#include <zephyr/kernel.h>
#include <zephyr/logging/log.h>
#include <zephyr/sys/poweroff.h>

#include "app.h"
#include "ble.h"
#include "buttons.h"
#include "led.h"
#include "power.h"
#include "rtc.h"

LOG_MODULE_REGISTER(main);

static void led_test(void) {
  LOG_INF("Testing LEDs...");
  for (int i = 0; i < 3; ++i) {
    led_set_color(0x20, 0x00, 0x00); /* red */
    k_msleep(200);
    led_set_color(0x00, 0x20, 0x00); /* green */
    k_msleep(200);
    led_set_color(0x00, 0x00, 0x20); /* blue */
    k_msleep(200);
  }
  led_set_color(0x00, 0x00, 0x00); /* off */
}

int main(void) {
  LOG_INF("K Watch starting");

  buttons_init();
  rtc_init();
  led_init();
  power_init();

  led_test();

  if (ble_init() < 0) {
    LOG_ERR("BLE init failed");
  }

  if (app_init() < 0) {
    LOG_ERR("UI init failed");
  }

  if (rtc_minute_alarm_enable() < 0) {
    LOG_ERR("RTC minute alarm init failed");
  }

  while (1) {
    app_task_handler();
  }
  return 0;
}
```

## src/ancs_client.c
```c
/*
 * Copyright (c) 2021 Nordic Semiconductor ASA
 *
 * SPDX-License-Identifier: LicenseRef-Nordic-5-Clause
 */

#include "ancs_client.h"

#include <bluetooth/gatt_dm.h>
#include <bluetooth/services/ancs_client.h>
#include <bluetooth/services/gattp.h>
#include <zephyr/bluetooth/bluetooth.h>
#include <zephyr/bluetooth/conn.h>
#include <zephyr/bluetooth/gatt.h>
#include <zephyr/bluetooth/hci.h>
#include <zephyr/bluetooth/uuid.h>
#include <zephyr/kernel.h>
#include <zephyr/logging/log.h>
#include <zephyr/sys/byteorder.h>
#include <zephyr/sys/printk.h>

LOG_MODULE_REGISTER(app_ancs_client);

/* Allocated size for attribute data. */
#define ATTR_DATA_SIZE BT_ANCS_ATTR_DATA_MAX

enum { DISCOVERY_ANCS_ONGOING, DISCOVERY_ANCS_SUCCEEDED, SERVICE_CHANGED_INDICATED };

static struct bt_ancs_client ancs_c;
static struct bt_gattp gattp;
static atomic_t discovery_flags;

/* Local copy to keep track of the newest arriving notifications. */
static struct bt_ancs_evt_notif notification_latest;
/* Local copy of the newest notification attribute. */
static struct bt_ancs_attr notif_attr_latest;
/* Local copy of the newest app attribute. */
static struct bt_ancs_attr notif_attr_app_id_latest;
/* Buffers to store attribute data. */
static uint8_t attr_appid[ATTR_DATA_SIZE];
static uint8_t attr_title[ATTR_DATA_SIZE];
static uint8_t attr_subtitle[ATTR_DATA_SIZE];
static uint8_t attr_message[ATTR_DATA_SIZE];
static uint8_t attr_message_size[ATTR_DATA_SIZE];
static uint8_t attr_date[ATTR_DATA_SIZE];
static uint8_t attr_posaction[ATTR_DATA_SIZE];
static uint8_t attr_negaction[ATTR_DATA_SIZE];
static uint8_t attr_disp_name[ATTR_DATA_SIZE];

/* String literals for the iOS notification categories. */
static const char *lit_catid[BT_ANCS_CATEGORY_ID_COUNT] = {
    "Other", "Incoming Call", "Missed Call",        "Voice Mail",           "Social",   "Schedule",
    "Email", "News",          "Health And Fitness", "Business And Finance", "Location", "Entertainment"};

/* String literals for the iOS notification event types. */
static const char *lit_eventid[BT_ANCS_EVT_ID_COUNT] = {"Added", "Modified", "Removed"};

/* String literals for the iOS notification attribute types. */
static const char *lit_attrid[BT_ANCS_NOTIF_ATTR_COUNT] = {
    "App Identifier",       "Title", "Subtitle", "Message", "Message Size", "Date", "Positive Action Label",
    "Negative Action Label"};

/* String literals for the iOS notification attribute types. */
static const char *lit_appid[BT_ANCS_APP_ATTR_COUNT] = {"Display Name"};

static void discover_ancs_first(struct bt_conn *conn);
static void discover_ancs_again(struct bt_conn *conn);
static void bt_ancs_notification_source_handler(struct bt_ancs_client *ancs_c, int err,
                                                const struct bt_ancs_evt_notif *notif);
static void bt_ancs_data_source_handler(struct bt_ancs_client *ancs_c, const struct bt_ancs_attr_response *response);

static void enable_ancs_notifications(struct bt_ancs_client *ancs_c) {
  int err;

  err = bt_ancs_subscribe_notification_source(ancs_c, bt_ancs_notification_source_handler);
  if (err) {
    LOG_ERR("Failed to enable Notification Source notification (err %d)", err);
  }

  err = bt_ancs_subscribe_data_source(ancs_c, bt_ancs_data_source_handler);
  if (err) {
    LOG_ERR("Failed to enable Data Source notification (err %d)", err);
  }
}

static void discover_ancs_completed_cb(struct bt_gatt_dm *dm, void *ctx) {
  int err;
  struct bt_ancs_client *ancs_c = (struct bt_ancs_client *)ctx;
  struct bt_conn *conn = bt_gatt_dm_conn_get(dm);

  LOG_INF("The discovery procedure for ANCS succeeded");

  bt_gatt_dm_data_print(dm);

  err = bt_ancs_handles_assign(dm, ancs_c);
  if (err) {
    LOG_ERR("Could not init ANCS client object, error: %d", err);
  } else {
    atomic_set_bit(&discovery_flags, DISCOVERY_ANCS_SUCCEEDED);
    enable_ancs_notifications(ancs_c);
  }

  err = bt_gatt_dm_data_release(dm);
  if (err) {
    LOG_ERR("Could not release the discovery data, error code: %d", err);
  }

  atomic_clear_bit(&discovery_flags, DISCOVERY_ANCS_ONGOING);
  discover_ancs_again(conn);
}

static void discover_ancs_not_found_cb(struct bt_conn *conn, void *ctx) {
  LOG_WRN("ANCS could not be found during the discovery");

  atomic_clear_bit(&discovery_flags, DISCOVERY_ANCS_ONGOING);
  discover_ancs_again(conn);
}

static void discover_ancs_error_found_cb(struct bt_conn *conn, int err, void *ctx) {
  LOG_ERR("The discovery procedure for ANCS failed, err %d", err);

  atomic_clear_bit(&discovery_flags, DISCOVERY_ANCS_ONGOING);
  discover_ancs_again(conn);
}

static const struct bt_gatt_dm_cb discover_ancs_cb = {
    .completed = discover_ancs_completed_cb,
    .service_not_found = discover_ancs_not_found_cb,
    .error_found = discover_ancs_error_found_cb,
};

static void indicate_sc_cb(struct bt_gattp *gattp, const struct bt_gattp_handle_range *handle_range, int err) {
  if (!err) {
    atomic_set_bit(&discovery_flags, SERVICE_CHANGED_INDICATED);
    discover_ancs_again(gattp->conn);
  }
}

static void enable_gattp_indications(struct bt_gattp *gattp) {
  int err;

  err = bt_gattp_subscribe_service_changed(gattp, indicate_sc_cb);
  if (err) {
    LOG_ERR("Cannot subscribe to Service Changed indication (err %d)", err);
  }
}

static void discover_gattp_completed_cb(struct bt_gatt_dm *dm, void *ctx) {
  int err;
  struct bt_gattp *gattp = (struct bt_gattp *)ctx;
  struct bt_conn *conn = bt_gatt_dm_conn_get(dm);

  if (bt_gatt_dm_attr_cnt(dm) > 1) {
    LOG_INF("The discovery procedure for GATT Service succeeded");

    bt_gatt_dm_data_print(dm);

    err = bt_gattp_handles_assign(dm, gattp);
    if (err) {
      LOG_ERR("Could not init GATT Service client object, error: %d", err);
    } else {
      enable_gattp_indications(gattp);
    }
  } else {
    LOG_WRN("GATT Service could not be found during the discovery");
  }

  err = bt_gatt_dm_data_release(dm);
  if (err) {
    LOG_ERR("Could not release the discovery data, error code: %d", err);
  }

  discover_ancs_first(conn);
}

static void discover_gattp_not_found_cb(struct bt_conn *conn, void *ctx) {
  LOG_WRN("GATT Service could not be found during the discovery");

  discover_ancs_first(conn);
}

static void discover_gattp_error_found_cb(struct bt_conn *conn, int err, void *ctx) {
  LOG_ERR("The discovery procedure for GATT Service failed, err %d", err);

  discover_ancs_first(conn);
}

static const struct bt_gatt_dm_cb discover_gattp_cb = {
    .completed = discover_gattp_completed_cb,
    .service_not_found = discover_gattp_not_found_cb,
    .error_found = discover_gattp_error_found_cb,
};

static void discover_gattp(struct bt_conn *conn) {
  int err;

  err = bt_gatt_dm_start(conn, BT_UUID_GATT, &discover_gattp_cb, &gattp);
  if (err) {
    LOG_ERR("Failed to start discovery for GATT Service (err %d)", err);
  }
}

static void discover_ancs(struct bt_conn *conn, bool retry) {
  int err;

  /* 1 Service Discovery at a time */
  if (atomic_test_and_set_bit(&discovery_flags, DISCOVERY_ANCS_ONGOING)) {
    return;
  }

  /* If ANCS is found, do not discover again. */
  if (atomic_test_bit(&discovery_flags, DISCOVERY_ANCS_SUCCEEDED)) {
    atomic_clear_bit(&discovery_flags, DISCOVERY_ANCS_ONGOING);
    return;
  }

  /* Check that Service Changed indication is received before discovering ANCS again. */
  if (retry) {
    if (!atomic_test_and_clear_bit(&discovery_flags, SERVICE_CHANGED_INDICATED)) {
      atomic_clear_bit(&discovery_flags, DISCOVERY_ANCS_ONGOING);
      return;
    }
  }

  err = bt_gatt_dm_start(conn, BT_UUID_ANCS, &discover_ancs_cb, &ancs_c);
  if (err) {
    LOG_ERR("Failed to start discovery for ANCS (err %d)", err);
    atomic_clear_bit(&discovery_flags, DISCOVERY_ANCS_ONGOING);
  }
}

static void discover_ancs_first(struct bt_conn *conn) { discover_ancs(conn, false); }

static void discover_ancs_again(struct bt_conn *conn) { discover_ancs(conn, true); }

static void security_changed(struct bt_conn *conn, bt_security_t level, enum bt_security_err err) {
  if (!err) {
    if (bt_conn_get_security(conn) >= BT_SECURITY_L2) {
      discovery_flags = ATOMIC_INIT(0);
      discover_gattp(conn);
    }
  }
}

BT_CONN_CB_DEFINE(conn_callbacks) = {
    .security_changed = security_changed,
};

static void notif_print(const struct bt_ancs_evt_notif *notif) {
  LOG_INF("[%u] - %s: %s", (unsigned int)notif->notif_uid, lit_eventid[notif->evt_id], lit_catid[notif->category_id]);
}

static void notif_attr_print(const struct bt_ancs_attr *attr) {
  if (attr->attr_len != 0) {
    LOG_INF("%s: %s", lit_attrid[attr->attr_id], (char *)attr->attr_data);
  } else if (attr->attr_len == 0) {
    LOG_INF("%s: (N/A)", lit_attrid[attr->attr_id]);
  }
}

static void app_attr_print(const struct bt_ancs_attr *attr) {
  if (attr->attr_len != 0) {
    LOG_INF("%s: %s", lit_appid[attr->attr_id], (char *)attr->attr_data);
  } else if (attr->attr_len == 0) {
    LOG_INF("%s: (N/A)", lit_appid[attr->attr_id]);
  }
}

static void bt_ancs_notification_source_handler(struct bt_ancs_client *ancs_c, int err,
                                                const struct bt_ancs_evt_notif *notif) {
  if (!err) {
    notification_latest = *notif;
    notif_print(&notification_latest);
  }
}

static void bt_ancs_data_source_handler(struct bt_ancs_client *ancs_c, const struct bt_ancs_attr_response *response) {
  switch (response->command_id) {
    case BT_ANCS_COMMAND_ID_GET_NOTIF_ATTRIBUTES:
      notif_attr_latest = response->attr;
      notif_attr_print(&notif_attr_latest);
      if (response->attr.attr_id == BT_ANCS_NOTIF_ATTR_ID_APP_IDENTIFIER) {
        notif_attr_app_id_latest = response->attr;
      }
      break;

    case BT_ANCS_COMMAND_ID_GET_APP_ATTRIBUTES:
      app_attr_print(&response->attr);
      break;

    default:
      /* No implementation needed. */
      break;
  }
}

static int ancs_c_init(void) {
  int err;

  err = bt_ancs_client_init(&ancs_c);
  if (err) {
    return err;
  }

  err = bt_ancs_register_attr(&ancs_c, BT_ANCS_NOTIF_ATTR_ID_APP_IDENTIFIER, attr_appid, ATTR_DATA_SIZE);
  if (err) {
    return err;
  }

  err = bt_ancs_register_app_attr(&ancs_c, BT_ANCS_APP_ATTR_ID_DISPLAY_NAME, attr_disp_name, sizeof(attr_disp_name));
  if (err) {
    return err;
  }

  err = bt_ancs_register_attr(&ancs_c, BT_ANCS_NOTIF_ATTR_ID_TITLE, attr_title, ATTR_DATA_SIZE);
  if (err) {
    return err;
  }

  err = bt_ancs_register_attr(&ancs_c, BT_ANCS_NOTIF_ATTR_ID_MESSAGE, attr_message, ATTR_DATA_SIZE);
  if (err) {
    return err;
  }

  err = bt_ancs_register_attr(&ancs_c, BT_ANCS_NOTIF_ATTR_ID_SUBTITLE, attr_subtitle, ATTR_DATA_SIZE);
  if (err) {
    return err;
  }

  err = bt_ancs_register_attr(&ancs_c, BT_ANCS_NOTIF_ATTR_ID_MESSAGE_SIZE, attr_message_size, ATTR_DATA_SIZE);
  if (err) {
    return err;
  }

  err = bt_ancs_register_attr(&ancs_c, BT_ANCS_NOTIF_ATTR_ID_DATE, attr_date, ATTR_DATA_SIZE);
  if (err) {
    return err;
  }

  err = bt_ancs_register_attr(&ancs_c, BT_ANCS_NOTIF_ATTR_ID_POSITIVE_ACTION_LABEL, attr_posaction, ATTR_DATA_SIZE);
  if (err) {
    return err;
  }

  err = bt_ancs_register_attr(&ancs_c, BT_ANCS_NOTIF_ATTR_ID_NEGATIVE_ACTION_LABEL, attr_negaction, ATTR_DATA_SIZE);

  return err;
}

static int gattp_init(void) { return bt_gattp_init(&gattp); }

int ancs_client_init(void) {
  int err;

  err = ancs_c_init();
  if (err) {
    LOG_ERR("ANCS client init failed (err %d)", err);
    return err;
  }

  err = gattp_init();
  if (err) {
    LOG_ERR("GATT Service client init failed (err %d)", err);
    return err;
  }

  return 0;
}
```

## src/ancs_client.h
```c
#ifndef ANCS_CLIENT_H
#define ANCS_CLIENT_H

#include <zephyr/bluetooth/conn.h>

int ancs_client_init(void);

#endif  // ANCS_CLIENT_H
```

## src/app.c
```c
#include "app.h"

#include <lvgl.h>
#include <stdint.h>
#include <sys/_stdint.h>
#include <zephyr/kernel.h>
#include <zephyr/logging/log.h>
#include <zephyr/sys/util.h>

#include "app/model.h"
#include "app/modes.h"
#include "app/screen.h"
#include "app/screens/noti_screen.h"
#include "app/screens/watchface_screen.h"
#include "display/lv_display.h"
#include "driver/LPM013M126A.h"
#include "hal/ancs_client.h"
#include "misc/lv_color.h"
#include "rtc.h"
#include "ui/ui.h"

LOG_MODULE_REGISTER(ui_module, LOG_LEVEL_DBG);

#define UI_LCD_WIDTH LCD_DEVICE_WIDTH
#define UI_LCD_HEIGHT LCD_DEVICE_HEIGHT

#define UI_DRAW_BUF_PIXELS (UI_LCD_WIDTH * UI_LCD_HEIGHT)
#define UI_DRAW_BUF_BYTES (UI_DRAW_BUF_PIXELS * LV_COLOR_FORMAT_GET_SIZE(LV_COLOR_FORMAT_RGB565))

static uint8_t draw_buf_mem[UI_DRAW_BUF_BYTES] __aligned(16);

static lv_display_t* disp;
static screen_t* current_screen = NULL;

static uint8_t rgb565_to_lcd4(uint16_t rgb565) {
  uint8_t r5 = (rgb565 >> 11) & 0x1F;
  uint8_t g6 = (rgb565 >> 5) & 0x3F;
  uint8_t b5 = rgb565 & 0x1F;
  uint8_t r1 = (r5 >= 16U) ? 1U : 0U;
  uint8_t g1 = (g6 >= 32U) ? 1U : 0U;
  uint8_t b1 = (b5 >= 16U) ? 1U : 0U;

  return (uint8_t)((((r1 << 2) | (g1 << 1) | b1) << 1) & 0x0F);
}

static void ui_display_flush_cb(lv_display_t* display, const lv_area_t* area, uint8_t* px_map) {
  for (int y = area->y1; y <= area->y2; y++) {
    for (int x = area->x1; x <= area->x2; x++) {
      uint16_t rgb565 = (uint16_t)px_map[0] | ((uint16_t)px_map[1] << 8);
      cmlcd_draw_pixel((int16_t)x, (int16_t)y, rgb565_to_lcd4(rgb565));
      px_map += 2;
    }
  }
  LOG_DBG("Flushed area x1:%d y1:%d x2:%d y2:%d", area->x1, area->y1, area->x2, area->y2);
  cmlcd_refresh();
  lv_display_flush_ready(display);
}

void app_switch_screen(screen_t* screen) {
  if (screen == NULL || screen == current_screen) {
    return;
  }
  current_screen = screen;
  if (current_screen->load) {
    current_screen->load();
  }
}

int app_init(void) {
  int ret;

  ret = cmlcd_init();
  if (ret < 0) {
    LOG_ERR("Display init failed: %d", ret);
    return ret;
  }

  cmlcd_set_blink_mode(LCD_BLINKMODE_NONE);
  cmlcd_cls();
  cmlcd_refresh();

#if !IS_ENABLED(CONFIG_LV_Z_AUTO_INIT)
  lv_init();
#endif
  memset(draw_buf_mem, 0, sizeof(draw_buf_mem));
  disp = lv_display_create(UI_LCD_WIDTH, UI_LCD_HEIGHT);
  LOG_INF("LVGL display created at %p", disp);
  lv_display_delete(lv_display_get_default());
  lv_display_set_default(disp);
  lv_display_set_color_format(disp, LV_COLOR_FORMAT_RGB565);
  lv_display_set_flush_cb(disp, ui_display_flush_cb);
  lv_display_set_buffers(disp, draw_buf_mem, NULL, UI_DRAW_BUF_BYTES, LV_DISPLAY_RENDER_MODE_FULL);

  ui_init();
  LOG_INF("UI init done");

  // Initialize screens
  watchface_screen.init();
  noti_screen.init();

  // Initialize modes
  modes_init();

  // Load default screen
  app_switch_screen(&watchface_screen);

  return 0;
}

// No message queue or posting logic here anymore

uint32_t app_task_handler(void) {
  uint32_t sleep = 1;
  while (1) {
    app_event_t event;
    while (event_get(&event, K_MSEC(sleep)) == 0) {
      LOG_INF("Handling event type: %u", event.type);
      if (event.type == APP_EVENT_BLE_ANCS) {
        // App handles notification management first
        if (event.ptr) {
          model_add_notification((ancs_noti_info_t*)event.ptr);
          k_free(event.ptr);
          model_dump_notifications();
        }
      } else if (event.type == APP_EVENT_BUTTON) {
        modes_activity_detected();
      } else if (event.type == APP_EVENT_MODE_TIMEOUT) {
        modes_handle_timeout();
      }

      if (current_screen && current_screen->handle_event) {
        current_screen->handle_event(&event);
      }
    }
    sleep = lv_timer_handler();
    if (sleep > 1000) {
      sleep = 1000;
    }
  }
}
```

## src/app.cpp
```c
#include "app.hpp"

#include <lvgl.h>
#include <stdint.h>
#include <zephyr/kernel.h>
#include <zephyr/logging/log.h>
#include <zephyr/sys/util.h>

#include "app/model.hpp"
#include "app/modes.hpp"
#include "app/screen.hpp"
#include "app/screens/noti_screen.hpp"
#include "app/screens/watchface_screen.hpp"
#include "display/lv_display.h"
#include "hal/ancs_client.hpp"
#include "hal/rtc.hpp"
#include "ui/ui.h"

LOG_MODULE_REGISTER(ui_module_cpp, LOG_LEVEL_DBG);

#define UI_LCD_WIDTH LCD_DEVICE_WIDTH
#define UI_LCD_HEIGHT LCD_DEVICE_HEIGHT

#define UI_DRAW_BUF_PIXELS (UI_LCD_WIDTH * UI_LCD_HEIGHT)
#define UI_DRAW_BUF_BYTES (UI_DRAW_BUF_PIXELS * LV_COLOR_FORMAT_GET_SIZE(LV_COLOR_FORMAT_RGB565))

static uint8_t draw_buf_mem[UI_DRAW_BUF_BYTES] __aligned(16);
static lv_display_t* disp_ptr;

static uint8_t rgb565_to_lcd4(uint16_t rgb565) {
  uint8_t r5 = (rgb565 >> 11) & 0x1F;
  uint8_t g6 = (rgb565 >> 5) & 0x3F;
  uint8_t b5 = rgb565 & 0x1F;
  uint8_t r1 = (r5 >= 16U) ? 1U : 0U;
  uint8_t g1 = (g6 >= 32U) ? 1U : 0U;
  uint8_t b1 = (b5 >= 16U) ? 1U : 0U;

  return (uint8_t)((((r1 << 2) | (g1 << 1) | b1) << 1) & 0x0F);
}

static void ui_display_flush_cb(lv_display_t* display, const lv_area_t* area, uint8_t* px_map) {
  for (int y = area->y1; y <= area->y2; y++) {
    for (int x = area->x1; x <= area->x2; x++) {
      uint16_t rgb565 = (uint16_t)px_map[0] | ((uint16_t)px_map[1] << 8);
      cmlcd_draw_pixel((int16_t)x, (int16_t)y, rgb565_to_lcd4(rgb565));
      px_map += 2;
    }
  }
  LOG_DBG("Flushed area x1:%d y1:%d x2:%d y2:%d", area->x1, area->y1, area->x2, area->y2);
  cmlcd_refresh();
  lv_display_flush_ready(display);
}

void App::switch_screen(Screen* screen) {
  if (screen == nullptr || screen == current_screen_) {
    return;
  }
  current_screen_ = screen;
  current_screen_->load();
}

K_MSGQ_DEFINE(app_msgq_cpp, sizeof(app_event_t), 10, 4);

int App::init() {
  int ret;

  ret = cmlcd_init();
  if (ret < 0) {
    LOG_ERR("Display init failed: %d", ret);
    return ret;
  }

  cmlcd_set_blink_mode(LCD_BLINKMODE_NONE);
  cmlcd_cls();
  cmlcd_refresh();

#if !IS_ENABLED(CONFIG_LV_Z_AUTO_INIT)
  lv_init();
#endif
  memset(draw_buf_mem, 0, sizeof(draw_buf_mem));
  disp_ptr = lv_display_create(UI_LCD_WIDTH, UI_LCD_HEIGHT);
  LOG_INF("LVGL display created at %p", disp_ptr);
  lv_display_delete(lv_display_get_default());
  lv_display_set_default(disp_ptr);
  lv_display_set_color_format(disp_ptr, LV_COLOR_FORMAT_RGB565);
  lv_display_set_flush_cb(disp_ptr, ui_display_flush_cb);
  lv_display_set_buffers(disp_ptr, draw_buf_mem, NULL, UI_DRAW_BUF_BYTES, LV_DISPLAY_RENDER_MODE_FULL);

  ui_init();
  LOG_INF("UI init done");

  // Initialize screens
  WatchfaceScreen::instance().init();
  NotiScreen::instance().init();

  // Initialize modes
  Modes::instance().init();

  // Load default screen
  switch_screen(&WatchfaceScreen::instance());

  return 0;
}

int App::event_post(app_event_t* event) {
  LOG_INF("Posting event type: %u", event->type);
  return k_msgq_put(&app_msgq_cpp, event, K_NO_WAIT);
}

uint32_t App::task_handler() {
  uint32_t sleep = 1;
  while (1) {
    app_event_t event;
    while (k_msgq_get(&app_msgq_cpp, &event, K_MSEC(sleep)) == 0) {
      LOG_INF("Handling event type: %u", event.type);
      if (event.type == APP_EVENT_BLE_ANCS) {
        // App handles notification management first
        if (event.ptr) {
          Model::instance().add_notification((ancs_noti_info_t*)event.ptr);
          k_free(event.ptr);
          Model::instance().dump_notifications();
        }
      } else if (event.type == APP_EVENT_BUTTON) {
        Modes::instance().activity_detected();
      } else if (event.type == APP_EVENT_MODE_TIMEOUT) {
        Modes::instance().handle_timeout();
      }

      if (current_screen_) {
        current_screen_->handle_event(&event);
      }
    }
    sleep = lv_timer_handler();
    if (sleep > 1000) {
      sleep = 1000;
    }
  }
}
```

## src/app.h
```c
#ifndef APP_H
#define APP_H

#include "event.h"

int app_init(void);
uint32_t app_task_handler(void);

struct screen;
void app_switch_screen(struct screen* screen);

#endif /* APP_H */
```

## src/app.hpp
```c
#ifndef APP_HPP
#define APP_HPP

#include <stdint.h>

#include "app/screen.hpp"
#include "event.h"

class App {
 public:
  static App& instance() {
    static App inst;
    return inst;
  }

  int init();
  uint32_t task_handler();
  int event_post(app_event_t* event);
  void switch_screen(Screen* screen);

 private:
  App() : current_screen_(nullptr) {}

  Screen* current_screen_;
  struct k_msgq msgq_;
};

#endif /* APP_HPP */
```

## src/ble.c
```c
#include "ble.h"

#include <bluetooth/services/ancs_client.h>
#include <bluetooth/services/cts_client.h>
#include <zephyr/bluetooth/bluetooth.h>
#include <zephyr/bluetooth/conn.h>
#include <zephyr/bluetooth/gatt.h>
#include <zephyr/bluetooth/hci.h>
#include <zephyr/bluetooth/uuid.h>
#include <zephyr/kernel.h>
#include <zephyr/logging/log.h>
#include <zephyr/settings/settings.h>

#include "ancs_client.h"
#include "cts_client.h"

LOG_MODULE_REGISTER(ble);

#define DEVICE_NAME CONFIG_BT_DEVICE_NAME
#define DEVICE_NAME_LEN (sizeof(DEVICE_NAME) - 1)

static struct k_work adv_work;

static const struct bt_data ad[] = {
    BT_DATA_BYTES(BT_DATA_FLAGS, (BT_LE_AD_GENERAL | BT_LE_AD_NO_BREDR)),
    BT_DATA_BYTES(BT_DATA_SOLICIT16, BT_UUID_16_ENCODE(BT_UUID_CTS_VAL)),
    BT_DATA_BYTES(BT_DATA_SOLICIT128, BT_UUID_ANCS_VAL),
};

static const struct bt_data sd[] = {
    BT_DATA(BT_DATA_NAME_COMPLETE, DEVICE_NAME, DEVICE_NAME_LEN),
};

static void adv_work_handler(struct k_work *work) {
  int err;

  ARG_UNUSED(work);

  err = bt_le_adv_start(BT_LE_ADV_CONN_FAST_2, ad, ARRAY_SIZE(ad), sd, ARRAY_SIZE(sd));
  if (err) {
    LOG_ERR("Advertising failed to start (err %d)", err);
    return;
  }

  LOG_INF("Advertising successfully started");
}

static void advertising_start(void) { k_work_submit(&adv_work); }

static void connected(struct bt_conn *conn, uint8_t err) {
  char addr[BT_ADDR_LE_STR_LEN];
  int sec_err;

  if (err) {
    LOG_ERR("Connection failed, err 0x%02x %s", err, bt_hci_err_to_str(err));
    return;
  }

  bt_addr_le_to_str(bt_conn_get_dst(conn), addr, sizeof(addr));
  LOG_INF("Connected %s", addr);

  sec_err = bt_conn_set_security(conn, BT_SECURITY_L2);
  if (sec_err) {
    LOG_ERR("Failed to set security (err %d)", sec_err);
  }
}

static void disconnected(struct bt_conn *conn, uint8_t reason) {
  char addr[BT_ADDR_LE_STR_LEN];

  bt_addr_le_to_str(bt_conn_get_dst(conn), addr, sizeof(addr));
  LOG_INF("Disconnected from %s, reason 0x%02x %s", addr, reason, bt_hci_err_to_str(reason));

  advertising_start();
}

static void security_changed(struct bt_conn *conn, bt_security_t level, enum bt_security_err err) {
  char addr[BT_ADDR_LE_STR_LEN];

  bt_addr_le_to_str(bt_conn_get_dst(conn), addr, sizeof(addr));

  if (!err) {
    LOG_INF("Security changed: %s level %u", addr, level);
  } else {
    LOG_ERR("Security failed: %s level %u err %d %s", addr, level, err, bt_security_err_to_str(err));
  }
}

static void recycled_cb(void) {
  LOG_INF("Connection object available from previous conn. Disconnect is complete!");
  advertising_start();
}

BT_CONN_CB_DEFINE(conn_callbacks) = {
    .connected = connected,
    .disconnected = disconnected,
    .security_changed = security_changed,
    .recycled = recycled_cb,
};

static void auth_cancel(struct bt_conn *conn) {
  char addr[BT_ADDR_LE_STR_LEN];

  bt_addr_le_to_str(bt_conn_get_dst(conn), addr, sizeof(addr));

  LOG_WRN("Pairing cancelled: %s", addr);

  bt_conn_disconnect(conn, BT_HCI_ERR_REMOTE_USER_TERM_CONN);
}

static void pairing_complete(struct bt_conn *conn, bool bonded) {
  char addr[BT_ADDR_LE_STR_LEN];

  bt_addr_le_to_str(bt_conn_get_dst(conn), addr, sizeof(addr));

  LOG_INF("Pairing completed: %s, bonded: %d", addr, bonded);
}

static void pairing_failed(struct bt_conn *conn, enum bt_security_err reason) {
  char addr[BT_ADDR_LE_STR_LEN];

  bt_addr_le_to_str(bt_conn_get_dst(conn), addr, sizeof(addr));

  LOG_ERR("Pairing failed conn: %s, reason %d %s", addr, reason, bt_security_err_to_str(reason));

  bt_conn_disconnect(conn, BT_HCI_ERR_REMOTE_USER_TERM_CONN);
}

static struct bt_conn_auth_cb conn_auth_callbacks = {
    .cancel = auth_cancel,
};

static struct bt_conn_auth_info_cb conn_auth_info_callbacks = {
    .pairing_complete = pairing_complete,
    .pairing_failed = pairing_failed,
};

int ble_init(void) {
  int err;

  err = bt_enable(NULL);
  if (err) {
    LOG_ERR("BLE init failed (err %d)", err);
    return err;
  }

  if (IS_ENABLED(CONFIG_SETTINGS)) {
    settings_load();
  }

  err = bt_conn_auth_cb_register(&conn_auth_callbacks);
  if (err) {
    LOG_ERR("Failed to register authorization callbacks");
    return err;
  }

  err = bt_conn_auth_info_cb_register(&conn_auth_info_callbacks);
  if (err) {
    LOG_ERR("Failed to register authorization info callbacks");
    return err;
  }

  err = cts_client_init();
  if (err) {
    LOG_ERR("CTS client init failed (err %d)", err);
    return err;
  }

  err = ancs_client_init();
  if (err) {
    LOG_ERR("ANCS client init failed (err %d)", err);
    return err;
  }

  k_work_init(&adv_work, adv_work_handler);
  advertising_start();

  return 0;
}
```

## src/buttons.c
```c
#include <zephyr/device.h>
#include <zephyr/drivers/gpio.h>
#include <zephyr/kernel.h>
#include <zephyr/logging/log.h>

#include "driver/LPM013M126A.h"

LOG_MODULE_REGISTER(buttons);

#define BUTTON_NODE(i) DT_ALIAS(sw##i)

#define BUTTON_SPEC(i) GPIO_DT_SPEC_GET(BUTTON_NODE(i), gpios)
#define BUTTON_LABEL(i) DT_PROP(BUTTON_NODE(i), label)

#define NUM_BUTTONS 4

static const struct gpio_dt_spec buttons[NUM_BUTTONS] = {
    BUTTON_SPEC(0),
    BUTTON_SPEC(1),
    BUTTON_SPEC(2),
    BUTTON_SPEC(3),
};

static struct gpio_callback button_cb_data[NUM_BUTTONS];

static const char* button_labels[NUM_BUTTONS] = {
    BUTTON_LABEL(0),
    BUTTON_LABEL(1),
    BUTTON_LABEL(2),
    BUTTON_LABEL(3),
};
uint32_t current_brightness = 0;
static void button_pressed(const struct device* dev, struct gpio_callback* cb, uint32_t pins) {
  for (int i = 0; i < NUM_BUTTONS; i++) {
    if (pins & BIT(buttons[i].pin)) {
      LOG_INF("%s pressed", button_labels[i]);
      if (i == 0) {
        // Button 1: Toggle brightness between 0 and 100%
        if (current_brightness < 100) {
          current_brightness += 10;
        }
      } else if (i == 2) {
        if (current_brightness > 0) {
          current_brightness -= 10;
        }
      }
      LOG_INF("Setting brightness to %d%%", current_brightness);
      cmlcd_backlight_set(100 - current_brightness);
    }
  }
}

static int init_button(int idx) {
  int ret;
  const struct gpio_dt_spec* btn = &buttons[idx];

  if (!gpio_is_ready_dt(btn)) {
    LOG_ERR("%s device not ready", button_labels[idx]);
    return -ENODEV;
  }

  ret = gpio_pin_configure_dt(btn, GPIO_INPUT);
  if (ret < 0) {
    LOG_ERR("Failed to configure %s: %d", button_labels[idx], ret);
    return ret;
  }

  ret = gpio_pin_interrupt_configure_dt(btn, GPIO_INT_EDGE_TO_ACTIVE);
  if (ret < 0) {
    LOG_ERR("Failed to configure %s interrupt: %d", button_labels[idx], ret);
    return ret;
  }

  gpio_init_callback(&button_cb_data[idx], button_pressed, BIT(btn->pin));
  gpio_add_callback(btn->port, &button_cb_data[idx]);

  LOG_INF("%s initialized", button_labels[idx]);
  return 0;
}

int buttons_init(void) {
  int ret;

  for (int i = 0; i < NUM_BUTTONS; i++) {
    ret = init_button(i);
    if (ret < 0) {
      return ret;
    }
  }

  return 0;
}
```

## src/cts_client.c
```c
#include "cts_client.h"

#include <bluetooth/gatt_dm.h>
#include <bluetooth/services/cts_client.h>
#include <zephyr/bluetooth/bluetooth.h>
#include <zephyr/bluetooth/conn.h>
#include <zephyr/bluetooth/hci.h>
#include <zephyr/bluetooth/uuid.h>
#include <zephyr/kernel.h>
#include <zephyr/logging/log.h>

#include "rtc.h"

LOG_MODULE_REGISTER(app_cts_client);

static struct bt_cts_client cts_c;
static bool has_cts;

static bool cts_to_rtc_time(const struct bt_cts_current_time *cts, struct rtc_time *out) {
  uint8_t dow;

  if ((cts->exact_time_256.year == 0) || (cts->exact_time_256.month == 0) || (cts->exact_time_256.day == 0)) {
    return false;
  }

  out->tm_year = cts->exact_time_256.year - 1900;
  out->tm_mon = cts->exact_time_256.month - 1;
  out->tm_mday = cts->exact_time_256.day;
  out->tm_hour = cts->exact_time_256.hours;
  out->tm_min = cts->exact_time_256.minutes;
  out->tm_sec = cts->exact_time_256.seconds;

  dow = cts->exact_time_256.day_of_week;
  if ((dow >= 1) && (dow <= 7)) {
    out->tm_wday = dow % 7;
  } else {
    out->tm_wday = 0;
  }

  return true;
}

static void apply_current_time(const struct bt_cts_current_time *current_time) {
  struct rtc_time rtc;
  int err;

  if (!cts_to_rtc_time(current_time, &rtc)) {
    LOG_WRN("CTS time invalid");
    return;
  }

  err = rtc_time_set(&rtc);
  if (err) {
    LOG_ERR("RTC set failed: %d", err);
    return;
  }

  LOG_INF("RTC synced: %04d-%02d-%02d %02d:%02d:%02d", rtc.tm_year + 1900, rtc.tm_mon + 1, rtc.tm_mday, rtc.tm_hour,
          rtc.tm_min, rtc.tm_sec);
}

static void notify_current_time_cb(struct bt_cts_client *cts, struct bt_cts_current_time *current_time) {
  ARG_UNUSED(cts);
  apply_current_time(current_time);
}

static void read_current_time_cb(struct bt_cts_client *cts, struct bt_cts_current_time *current_time, int err) {
  ARG_UNUSED(cts);

  if (err) {
    LOG_ERR("CTS read failed: %d", err);
    return;
  }

  apply_current_time(current_time);
}

static void enable_notifications(void) {
  int err;

  if (!has_cts || (bt_conn_get_security(cts_c.conn) < BT_SECURITY_L2)) {
    return;
  }

  err = bt_cts_subscribe_current_time(&cts_c, notify_current_time_cb);
  if (err) {
    LOG_ERR("CTS notify subscribe failed: %d", err);
    return;
  }

  err = bt_cts_read_current_time(&cts_c, read_current_time_cb);
  if (err) {
    LOG_ERR("CTS initial read failed: %d", err);
  }
}

static void discover_completed_cb(struct bt_gatt_dm *dm, void *ctx) {
  int err;

  ARG_UNUSED(ctx);

  LOG_INF("CTS discovery complete");

  err = bt_cts_handles_assign(dm, &cts_c);
  if (err) {
    LOG_ERR("CTS handle assign failed: %d", err);
  } else {
    has_cts = true;

    if (bt_conn_get_security(cts_c.conn) < BT_SECURITY_L2) {
      err = bt_conn_set_security(cts_c.conn, BT_SECURITY_L2);
      if (err) {
        LOG_ERR("Set security failed: %d", err);
      }
    } else {
      enable_notifications();
    }
  }

  err = bt_gatt_dm_data_release(dm);
  if (err) {
    LOG_ERR("CTS discovery release failed: %d", err);
  }
}

static void discover_service_not_found_cb(struct bt_conn *conn, void *ctx) {
  ARG_UNUSED(conn);
  ARG_UNUSED(ctx);

  LOG_WRN("CTS not found");
}

static void discover_error_found_cb(struct bt_conn *conn, int err, void *ctx) {
  ARG_UNUSED(conn);
  ARG_UNUSED(ctx);

  LOG_ERR("CTS discovery failed: %d", err);
}

static const struct bt_gatt_dm_cb discover_cb = {
    .completed = discover_completed_cb,
    .service_not_found = discover_service_not_found_cb,
    .error_found = discover_error_found_cb,
};

static void connected(struct bt_conn *conn, uint8_t err) {
  if (err) {
    return;
  }

  has_cts = false;

  err = bt_gatt_dm_start(conn, BT_UUID_CTS, &discover_cb, NULL);
  if (err) {
    LOG_ERR("CTS discovery start failed: %d", err);
  }
}

static void security_changed(struct bt_conn *conn, bt_security_t level, enum bt_security_err err) {
  if (!err) {
    enable_notifications();
  }
}

BT_CONN_CB_DEFINE(conn_callbacks) = {
    .connected = connected,
    .security_changed = security_changed,
};

int cts_client_init(void) {
  int err;

  err = bt_cts_client_init(&cts_c);
  if (err) {
    LOG_ERR("CTS client init failed: %d", err);
    return err;
  }

  return 0;
}
```

## src/cts_client.h
```c
#ifndef CTS_CLIENT_H
#define CTS_CLIENT_H

int cts_client_init(void);

#endif /* CTS_CLIENT_H */
```

## src/display.c
```c
#include "display.h"

#include <zephyr/kernel.h>
#include <zephyr/logging/log.h>

#include "driver/LPM013M126A.h"
#include "image_176x176_4bpp.h"

LOG_MODULE_REGISTER(display_module);

static void display_draw_4bpp(int x0, int y0, int width, int height, const uint8_t *buf) {
  int bytes_per_row = width / 2;

  for (int y = 0; y < height; y++) {
    for (int xb = 0; xb < bytes_per_row; xb++) {
      uint8_t packed = buf[(y * bytes_per_row) + xb];
      uint8_t px0 = (packed >> 4) & 0x0F;
      uint8_t px1 = packed & 0x0F;

      cmlcd_draw_pixel(x0 + (xb * 2), y0 + y, px0);
      cmlcd_draw_pixel(x0 + (xb * 2) + 1, y0 + y, px1);
    }
  }
}

int display_test(void) {
  int ret = cmlcd_init();
  if (ret < 0) {
    LOG_ERR("Display init failed: %d", ret);
    return ret;
  }

  LOG_INF("Display test start");

  cmlcd_set_blink_mode(LCD_BLINKMODE_NONE);

  display_draw_4bpp(0, 0, IMAGE_176X176_4BPP_WIDTH, IMAGE_176X176_4BPP_HEIGHT, image_176x176_4bpp);
  cmlcd_refresh();

  cmlcd_backlight_set(100);

  LOG_INF("Display test done");
  return 0;
}
```

## src/display.h
```c
#ifndef DISPLAY_H
#define DISPLAY_H

int display_test(void);

#endif /* DISPLAY_H */
```
